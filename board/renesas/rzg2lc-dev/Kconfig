## board/renesas/rzg2lc-dev/Kconfig
```kconfig
if TARGET_RZG2LC_DEV

config SYS_SOC
	default "rmobile"

config SYS_BOARD
	default "rzg2lc-dev"

config SYS_VENDOR
	default "renesas"

config SYS_CONFIG_NAME
	default "rzg2lc-dev"

endif

if TARGET_SMARC_RZG2LC

config SYS_SOC
	default "rmobile"

config SYS_BOARD
	default "rzg2lc-dev"

config SYS_VENDOR
	default "renesas"

config SYS_CONFIG_NAME
	default "smarc-rzg2lc"

endif

if TARGET_SMARC_RZG2L

config SYS_SOC
	default "rmobile"

config SYS_BOARD
	default "rzg2l-dev"

config SYS_VENDOR
	default "renesas"

config SYS_CONFIG_NAME
	default "aaasmarc-rzg2l"

endif
```
